## firmware/esp/12vhpwr-proto/main/Kconfig.projbuild
```kconfig
menu "12vhpwr-proto bring-up"

    config CEC_PROTO_RAW_CONSOLE
        bool "v0 raw console loop (simulation-verified bring-up path)"
        default y
        help
            Run the v0 raw printf loop (poll DRDY, pull a frame, print
            codes + volts at ~5 Hz) instead of the TelePlot streaming
            loop. Default ON until bring-up step 3 passes on hardware,
            so the first hardware session uses the exact path verified
            in simulation. The TelePlot path and the CLI 'frame' command
            compile in either mode.

endmenu
```

## firmware/esp/components/cec_comms/Kconfig
```kconfig
menu "CEC comms (CAN/TWAI)"

    config CEC_CAN_BITRATE_BPS
        int "CAN bus bitrate (bps)"
        default 125000
        help
            PRODUCTION TARGET IS 500000 (matches the 24-pin + Hub
            platform spec, classical CAN at 500 kbps). The default is
            parked at the bench rate of 125000 because the Waveshare
            SN65HVD230 bench breakout ties the transceiver Rs pin to
            GND through a 10 kohm resistor, putting it in slope-control
            mode; the slewed edges trip the controller's bit-monitoring
            at 500 kbps and the node bus-offs every few seconds, while
            125 kbps gives the edges enough margin.

            Raise to 500000 once either the bench breakout's Rs pin is
            bridged directly to GND (forcing high-speed mode), or the
            firmware runs against the production CAN front-end where Rs
            is wired straight to GND by design.

    config CEC_CAN_DIAG_LISTEN_ONLY
        bool "Force listen-only mode (bus-off triage diagnostic)"
        default n
        help
            Forces the controller into listen-only mode (no TX, no ACK,
            just RX-monitor). If bus-off still happens with this on,
            the controller / wire / bias is fundamentally broken and
            the TX path isn't the cause. If bus-off stops with this on
            but resumes with it off, every TX attempt is the trigger
            and the issue is downstream of TXD. Leave off for normal
            operation.

    config CEC_CAN_TX_GPIO
        int "CAN TX GPIO"
        default 4
        help
            TWAI TX pin (board wiring; the eps daughterboard uses 4).

    config CEC_CAN_RX_GPIO
        int "CAN RX GPIO"
        default 15
        help
            TWAI RX pin (board wiring; the eps daughterboard uses 15).

endmenu
```

## firmware/esp/components/cec_nvs/Kconfig
```kconfig
menu "CEC persistence (NVS / persist-on-fault)"

    config CEC_PERSIST_WRITE_BUDGET_MS
        int "Persist-on-fault trigger-to-durable-commit budget (ms)"
        default 10
        help
            The persist-on-fault contract's binding end-to-end budget
            (firmware/contracts/persist-on-fault.md): on the power-fail
            interrupt the gasp must complete ISR entry, load shedding,
            the RAM-tail write, commit/index programming, and durable
            completion within this many milliseconds. It is never a bulk
            dump, and the persist region is pre-erased in normal operation.

            The default 10 sits under the current-BETA conservative
            sudden-loss paper bound of 11.96 ms at the reviewed 215.386 mA
            rail load (including 20% design margin), minimum 3760 uF,
            worst-case SS14 drop, and 85% conversion. This leaves 1.96 ms
            model margin. OQ-56 must still validate ESR, temperature,
            aging, slow brownout, source decay, and real durable-commit
            latency. Re-tests update this default and the contract together;
            firmware must never re-hardcode the number.

endmenu
```

## firmware/esp/components/cec_sensors/Kconfig
```kconfig
menu "CEC sensors"

    choice CEC_ADC_BACKEND
        prompt "cec_adc backend"
        default CEC_ADC_BACKEND_ONESHOT
        help
            How cec_adc drives ADC1. Each app selects the backend its
            board architecture was built around (sdkconfig.defaults).

        config CEC_ADC_BACKEND_ONESHOT
            bool "adc_oneshot (averaged reads; pause/resume hand-off)"
            help
                eps lineage: per-read averaging, plus the pause/resume
                hand-off so cec_capture's adc_continuous HS path can
                borrow the unit.

        config CEC_ADC_BACKEND_CONTINUOUS
            bool "adc_continuous (DMA latest-mV table; fixed pattern)"
            help
                24-pin lineage: hardware-clocked sampling into a
                lock-free latest-mV table; samples param ignored.
    endchoice

    config CEC_SENSOR_ACS712
        bool "ACS712 Hall current sensor driver"
        default n

    config CEC_SENSOR_ACS758
        bool "ACS758 Hall current sensor driver"
        default n

    config CEC_SENSOR_INA226
        bool "INA226 I2C bus-monitor driver"
        default n

    config CEC_SENSOR_NTC
        bool "NTC thermistor driver (eps-named API)"
        default n
        help
            Same Beta-equation divider math as CEC_SENSOR_THERMISTOR;
            ntc.h is a compatibility header over the one shared source.

    config CEC_SENSOR_THERMISTOR
        bool "Thermistor driver (24-pin-named API)"
        default n

endmenu
```

## firmware/esp/components/cec_telemetry/Kconfig
```kconfig
menu "CEC telemetry"

    config CEC_TELEMETRY_UART0
        bool "Compile the dedicated TelePlot UART transport"
        default n
        help
            Routes every TelePlot line through a dedicated UART (the
            CH340K UART USB-C on the s3 boards, 921600 baud) once the
            app calls cec_telemetry_init_uart, keeping burst dumps off
            the CLI/console wire. Disabled: the init call returns
            ESP_ERR_NOT_SUPPORTED and TelePlot output stays on stdio.

endmenu
```
